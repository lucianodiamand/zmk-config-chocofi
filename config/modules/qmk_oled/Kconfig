## config/modules/qmk_oled/Kconfig
```kconfig
config CHOCOFI_QMK_OLED
    bool "QMK-style portrait dashboard"
    default y
    depends on ZMK_DISPLAY
    select LV_OBJ_LABEL
    select LV_FONT_UNSCII_8
```

## config/modules/qmk_oled/dts/bindings/behaviors/custom,case-key.yaml
```yaml
description: Chocofi case key
compatible: "custom,case-key"
include: one_param.yaml
```

## config/modules/qmk_oled/dts/bindings/behaviors/custom,case-mode.yaml
```yaml
description: Chocofi case mode
compatible: "custom,case-mode"
include: one_param.yaml
```

## config/modules/qmk_oled/dts/bindings/behaviors/custom,dashboard-sync.yaml
```yaml
description: Replicate dashboard state using the split global behavior transport
compatible: "custom,dashboard-sync"
include: two_param.yaml
```

## config/modules/qmk_oled/dts/bindings/behaviors/custom,symbol-key.yaml
```yaml
description: Shifted symbol with reference counted modifiers
compatible: "custom,symbol-key"
include: one_param.yaml
```

## config/modules/qmk_oled/dts/bindings/behaviors/custom,vowel-capture.yaml
```yaml
description: Capture vowel modifiers before deferred tap-dance
compatible: "custom,vowel-capture"
include: one_param.yaml
```
